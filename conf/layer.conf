## conf/layer.conf
```bitbake
# We have a conf and classes directory, add to BBPATH
BBPATH .= ":${LAYERDIR}"

# We have recipes-* directories, add to BBFILES
BBFILES += "${LAYERDIR}/common/recipes-*/*/*.bb \
            ${LAYERDIR}/common/recipes-*/*/*.bbappend"

BBFILE_COLLECTIONS += "rock"
BBFILE_PATTERN_rock := "^${LAYERDIR}/"
BBFILE_PRIORITY_rock = "15"
LAYERDEPENDS_rock = "intel"
BBMASK = "guile-native_1.8.7"
```

## conf/machine/include/rock.inc
```bitbake
#@DESCRIPTION: Generizized x86 Tablet settings

PREFERRED_PROVIDER_virtual/kernel ?= "linux-yocto"
PREFERRED_VERSION_linux-yocto ?= "3.4%"

DEFAULTTUNE ??= "core2"

require conf/machine/include/ia32-base.inc

SERIAL_CONSOLE=""

MACHINE_FEATURES +=" touchscreen wifi bluetooth zeroconf "
MACHINE_EXTRA_RDEPENDS +=" kernel-modules "
IMAGE_INSTALL_append =" linux-firmware curl opkg wireless-tools e2fsprogs"
WEBOS_IMAGE_EXTRA_INSTALL += "freetype fontconfig connman"
```

## conf/machine/include/tune-corei7-avx.inc
```bitbake
DEFAULTTUNE ?= "corei7-avx"

require conf/machine/include/tune-core2.inc

# Extra tune features
TUNEVALID[corei7-avx] = "Enable corei7-avx specific processor optimizations"
TUNE_CCARGS += "${@bb.utils.contains("TUNE_FEATURES", "corei7-avx", "-march=corei7-avx -mavx -mtune=corei7-avx -mfpmath=sse", "", d)}"

# Extra tune selections
AVAILTUNES += "corei7-avx"
TUNE_FEATURES_tune-corei7-avx = "${TUNE_FEATURES_tune-core2} corei7-avx"
BASE_LIB_tune-corei7-avx = "lib"
TUNE_PKGARCH_tune-corei7-avx = "corei7_avx"
PACKAGE_EXTRA_ARCHS_tune-corei7-avx = "${PACKAGE_EXTRA_ARCHS_tune-core2} corei7_avx"

AVAILTUNES += "corei7-avx-64"
TUNE_FEATURES_tune-corei7-avx-64 = "${TUNE_FEATURES_tune-core2-64} corei7-avx"
BASE_LIB_tune-corei7-avx-64 = "lib64"
TUNE_PKGARCH_tune-corei7-avx-64 = "corei7_avx_64"
PACKAGE_EXTRA_ARCHS_tune-corei7-avx-64 = "${PACKAGE_EXTRA_ARCHS_tune-core2-64} corei7_avx_64"

AVAILTUNES += "corei7-avx-64-x32"
TUNE_FEATURES_tune-corei7-avx-64-x32 = "${TUNE_FEATURES_tune-x86-64-x32} corei7-avx"
BASE_LIB_tune-corei7-avx-64-x32 = "libx32"
TUNE_PKGARCH_tune-corei7-avx-64-x32 = "core2_64_x32"
PACKAGE_EXTRA_ARCHS_tune-corei7-avx-64-x32 = "${PACKAGE_EXTRA_ARCHS_tune-core2-64-x32} corei7_avx_64_x32"
```

## meta-envy/conf/layer.conf
```bitbake
# We have a conf and classes directory, add to BBPATH
BBPATH := "${BBPATH}:${LAYERDIR}"

# We have recipes-* directories, add to BBFILES
BBFILES := "${BBFILES} ${LAYERDIR}/recipes-*/*/*.bb \
            ${LAYERDIR}/recipes-*/*/*.bbappend"

BBFILE_COLLECTIONS += "envy"
BBFILE_PATTERN_envy := "^${LAYERDIR}/"
BBFILE_PRIORITY_envy = "17"
LAYERDEPENDS_envy = "rock"
```

## meta-envy/conf/machine/envy.conf
```bitbake
#@TYPE: Machine
#@NAME: envy

#@DESCRIPTION: Machine configuration for the HP Envy x2 Machine.  
require conf/machine/include/tune-atom.inc

require conf/machine/include/ia32-base.inc

MACHINE_FEATURES += "pcbios grub-efi va-impl-intel"

XSERVER ?= "${XSERVER_IA32_BASE} \
           ${XSERVER_IA32_EXT} \
           cdv-pvr-driver \
           "
PREFERRED_PROVIDER_virtual/kernel ?= "linux-yocto"
PREFERRED_VERSION_linux-yocto ?= "3.0%"
PREFERRED_VERSION_xserver-xorg ?= "1.9.3"
PREFERRED_VERSION_mesa-dri ?= "8.0.4"
PREFERRED_VERSION_xf86-input-evdev ?= "2.6.0"

SYSLINUX_OPTS = "serial 0 115200"
SERIAL_CONSOLE = "115200 ttyS0"
APPEND += "console=ttyS0,115200 console=tty0"

VA_FEATURES ?= "gst-va-intel va-intel"

MACHINE_EXTRA_RRECOMMENDS += "${VA_FEATURES}"
```

## meta-slate/conf/layer.conf
```bitbake
# We have a conf and classes directory, add to BBPATH
BBPATH := "${BBPATH}:${LAYERDIR}"

# We have recipes-* directories, add to BBFILES
BBFILES := "${BBFILES} ${LAYERDIR}/recipes-*/*/*.bb \
            ${LAYERDIR}/recipes-*/*/*.bbappend"

BBFILE_COLLECTIONS += "slate"
BBFILE_PATTERN_slate := "^${LAYERDIR}/"
BBFILE_PRIORITY_slate = "16"
LAYERDEPENDS_slate = "rock"
```

## meta-slate/conf/machine/slate.conf
```bitbake
#@TYPE: Machine
#@NAME: slate

#@DESCRIPTION: Machine configuration for Samsung Series 7 Slate.  

PREFERRED_PROVIDER_virtual/kernel ?= "linux-yocto"
PREFERRED_VERSION_linux-yocto ?= "3.4%"

PREFERRED_VERSION_mesa-dri= "${AUTOREV}"

require conf/machine/include/tune-corei7-avx.inc

require conf/machine/include/rock.inc

SERIAL_CONSOLE=""

XSERVER ?= "${XSERVER_IA32_BASE} \
           ${XSERVER_IA32_EXT} \
           ${XSERVER_IA32_I965} \
           "

VA_FEATURES ?= "gst-va-intel va-intel"

MACHINE_EXTRA_RRECOMMENDS += "${VA_FEATURES}"

MACHINE_FEATURES +=" touchscreen wifi bluetooth zeroconf "

IMAGE_INSTALL_append_slate +=" kernel-module-iwlwifi sysstat liberation-fonts"
```
